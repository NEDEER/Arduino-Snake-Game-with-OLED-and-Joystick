/*
  Arduino Snake Game
  Hardware:
    - Arduino Nano
    - Joystick Module (X, Y, Button)
    - OLED Display (SSD1306, 128x64, I2C)

  Wiring:
    OLED:
      VCC -> 5V
      GND -> GND
      SCL -> A5
      SDA -> A4

    Joystick:
      VRx -> A0
      VRy -> A1
      SW  -> D2
      VCC -> 5V
      GND -> GND
*/

#include <Wire.h>
#include <Adafruit_GFX.h>
#include <Adafruit_SSD1306.h>

// OLED display size
#define SCREEN_WIDTH 128
#define SCREEN_HEIGHT 64

// Grid size (each cell is 4x4 pixels)
#define CELL_SIZE 4
#define GRID_WIDTH (SCREEN_WIDTH / CELL_SIZE)   // 32
#define GRID_HEIGHT (SCREEN_HEIGHT / CELL_SIZE) // 16

// Joystick pins
#define JOY_X A0
#define JOY_Y A1
#define JOY_SW 2

// OLED reset pin (not used with SSD1306 I2C)
#define OLED_RESET -1

Adafruit_SSD1306 display(SCREEN_WIDTH, SCREEN_HEIGHT, &Wire, OLED_RESET);

// Snake properties
#define MAX_SNAKE_LENGTH 64

struct Point {
  int8_t x;
  int8_t y;
};

Point snake[MAX_SNAKE_LENGTH];
uint8_t snakeLength = 3;
int8_t dirX = 1; // 1: right, -1: left, 0: no horizontal movement
int8_t dirY = 0; // 1: down, -1: up, 0: no vertical movement

Point food;

unsigned long lastMoveTime = 0;
unsigned long moveInterval = 150; // ms

bool gameOver = false;

// Splash screen bitmap (you can paste your own bitmap content here)
const unsigned char bitmap [] PROGMEM = {
  0x00, 0x00, 0x00, 0x00, 0x00, 0x00, 0x00, 0x00, 0x00, 0x00, 0x00, 0x00, 0x00, 0x00, 0x00, 0x00, 
  0x00, 0x00, 0x00, 0x00, 0x00, 0xc0, 0x00, 0x00, 0x00, 0x00, 0x00, 0x04, 0x00, 0x00, 0x00, 0x00, 
  0x00, 0x00, 0x00, 0x00, 0x01, 0xe0, 0x00, 0x00, 0x00, 0x00, 0x00, 0x0e, 0x00, 0x00, 0x00, 0x00, 
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  0x00, 0x00, 0x00, 0x00, 0x00, 0x00, 0x00, 0x00, 0x00, 0x00, 0x00, 0x00, 0x00, 0x00, 0x00, 0x00
};


// Function to generate random food position not on the snake
void spawnFood() {
  bool valid = false;
  while (!valid) {
    food.x = random(0, GRID_WIDTH);
    food.y = random(0, GRID_HEIGHT);
    valid = true;
    for (uint8_t i = 0; i < snakeLength; i++) {
      if (snake[i].x == food.x && snake[i].y == food.y) {
        valid = false;
        break;
      }
    }
  }
}

// Function to draw the snake and food
void drawGame() {
  display.clearDisplay();

  // Draw food
  display.fillRect(food.x * CELL_SIZE, food.y * CELL_SIZE, CELL_SIZE, CELL_SIZE, SSD1306_WHITE);

  // Draw snake
  for (uint8_t i = 0; i < snakeLength; i++) {
    display.drawRect(snake[i].x * CELL_SIZE, snake[i].y * CELL_SIZE, CELL_SIZE, CELL_SIZE, SSD1306_WHITE);
  }

  display.display();
}

// Function to check collision with self or wall
bool checkCollision(int8_t x, int8_t y) {
  if (x < 0 || x >= GRID_WIDTH || y < 0 || y >= GRID_HEIGHT) return true;
  for (uint8_t i = 0; i < snakeLength; i++) {
    if (snake[i].x == x && snake[i].y == y) return true;
  }
  return false;
}

// Function to read joystick and update direction
void readJoystick() {
  int xVal = analogRead(JOY_X);
  int yVal = analogRead(JOY_Y);
  int threshold = 200;

  if (abs(xVal - 512) > threshold && abs(dirX) == 0) {
    if (xVal < 400) { dirX = -1; dirY = 0; }
    else if (xVal > 600) { dirX = 1; dirY = 0; }
  } else if (abs(yVal - 512) > threshold && abs(dirY) == 0) {
    if (yVal < 400) { dirX = 0; dirY = -1; }
    else if (yVal > 600) { dirX = 0; dirY = 1; }
  }
}

// Reset game state
void resetGame() {
  snakeLength = 3;
  snake[0] = {GRID_WIDTH / 2, GRID_HEIGHT / 2};
  snake[1] = {GRID_WIDTH / 2 - 1, GRID_HEIGHT / 2};
  snake[2] = {GRID_WIDTH / 2 - 2, GRID_HEIGHT / 2};
  dirX = 1;
  dirY = 0;
  spawnFood();
  gameOver = false;
  lastMoveTime = millis();
}

void setup() {
  pinMode(JOY_SW, INPUT_PULLUP);

  if (!display.begin(SSD1306_SWITCHCAPVCC, 0x3C)) {
    for (;;);
  }

  // Show splash screen with bitmap
  display.clearDisplay();
  display.drawBitmap(0, 0, bitmap, 128, 64, SSD1306_WHITE);
  display.display();

  // Wait for button press
  while (digitalRead(JOY_SW) == HIGH) {
    delay(10);
  }
  delay(300); // Debounce

  // Optional title
  display.clearDisplay();
  display.setTextSize(1);
  display.setTextColor(SSD1306_WHITE);
  display.setCursor(10, 28);
  display.println("Arduino Snake!");
  display.setCursor(25, 48);
  display.println("NEDERR");
  display.display();
  delay(1500);

  randomSeed(analogRead(A3));
  resetGame();
}

void loop() {
  if (gameOver) {
    display.clearDisplay();
    display.setTextSize(2);
    display.setCursor(20, 20);
    display.println("Game Over");
    display.setTextSize(1);
    display.setCursor(25, 48);
    display.println("Press button");
    display.display();

    if (digitalRead(JOY_SW) == LOW) {
      delay(300); // Debounce
      resetGame();
    }
    return;
  }

  readJoystick();

  if (millis() - lastMoveTime > moveInterval) {
    lastMoveTime = millis();

    for (int i = snakeLength - 1; i > 0; i--) {
      snake[i] = snake[i - 1];
    }

    int8_t newX = snake[0].x + dirX;
    int8_t newY = snake[0].y + dirY;

    if (checkCollision(newX, newY)) {
      gameOver = true;
      return;
    }

    snake[0].x = newX;
    snake[0].y = newY;

    if (snake[0].x == food.x && snake[0].y == food.y) {
      if (snakeLength < MAX_SNAKE_LENGTH) {
        snakeLength++;
      }
      spawnFood();
    }

    drawGame();
  }
}
